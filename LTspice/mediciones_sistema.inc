* Mediciones automaticas del SISTEMA COMPLETO (T = 20 ms por codigo). Resultados en View > SPICE Error Log
* Para cada codigo kk (0..15), medido a mitad del intervalo del codigo:
*   VINTkk = V(V_INTERFAZ) [V]   ILEDkk = I(D_LED) [A]   RLDRkk = resistencia de la LDR [Ohm]
*   Fkk = frecuencia simulada del 555 [Hz]   FTEOkk = 1.443/((R1+2*RLDR)*C1) [Hz]   ERRkk = error de Fkk [%]
.meas TRAN VINT00 FIND V(V_INTERFAZ) AT 10m
.meas TRAN ILED00 FIND I(D_LED) AT 10m
.meas TRAN RLDR00 FIND V(RLDR) AT 10m
.meas TRAN PER00 TRIG V(OUT_555) VAL=2.5 TD=6m RISE=1 TARG V(OUT_555) VAL=2.5 TD=6m RISE=2
.meas TRAN F00 param 1/PER00
.meas TRAN FTEO00 param 1.443/((1k+2*RLDR00)*100n)
.meas TRAN ERR00 param abs(F00-FTEO00)/FTEO00*100
.meas TRAN VINT01 FIND V(V_INTERFAZ) AT 30m
.meas TRAN ILED01 FIND I(D_LED) AT 30m
.meas TRAN RLDR01 FIND V(RLDR) AT 30m
.meas TRAN PER01 TRIG V(OUT_555) VAL=2.5 TD=26m RISE=1 TARG V(OUT_555) VAL=2.5 TD=26m RISE=2
.meas TRAN F01 param 1/PER01
.meas TRAN FTEO01 param 1.443/((1k+2*RLDR01)*100n)
.meas TRAN ERR01 param abs(F01-FTEO01)/FTEO01*100
.meas TRAN VINT02 FIND V(V_INTERFAZ) AT 50m
.meas TRAN ILED02 FIND I(D_LED) AT 50m
.meas TRAN RLDR02 FIND V(RLDR) AT 50m
.meas TRAN PER02 TRIG V(OUT_555) VAL=2.5 TD=46m RISE=1 TARG V(OUT_555) VAL=2.5 TD=46m RISE=2
.meas TRAN F02 param 1/PER02
.meas TRAN FTEO02 param 1.443/((1k+2*RLDR02)*100n)
.meas TRAN ERR02 param abs(F02-FTEO02)/FTEO02*100
.meas TRAN VINT03 FIND V(V_INTERFAZ) AT 70m
.meas TRAN ILED03 FIND I(D_LED) AT 70m
.meas TRAN RLDR03 FIND V(RLDR) AT 70m
.meas TRAN PER03 TRIG V(OUT_555) VAL=2.5 TD=66m RISE=1 TARG V(OUT_555) VAL=2.5 TD=66m RISE=2
.meas TRAN F03 param 1/PER03
.meas TRAN FTEO03 param 1.443/((1k+2*RLDR03)*100n)
.meas TRAN ERR03 param abs(F03-FTEO03)/FTEO03*100
.meas TRAN VINT04 FIND V(V_INTERFAZ) AT 90m
.meas TRAN ILED04 FIND I(D_LED) AT 90m
.meas TRAN RLDR04 FIND V(RLDR) AT 90m
.meas TRAN PER04 TRIG V(OUT_555) VAL=2.5 TD=86m RISE=1 TARG V(OUT_555) VAL=2.5 TD=86m RISE=2
.meas TRAN F04 param 1/PER04
.meas TRAN FTEO04 param 1.443/((1k+2*RLDR04)*100n)
.meas TRAN ERR04 param abs(F04-FTEO04)/FTEO04*100
.meas TRAN VINT05 FIND V(V_INTERFAZ) AT 110m
.meas TRAN ILED05 FIND I(D_LED) AT 110m
.meas TRAN RLDR05 FIND V(RLDR) AT 110m
.meas TRAN PER05 TRIG V(OUT_555) VAL=2.5 TD=106m RISE=1 TARG V(OUT_555) VAL=2.5 TD=106m RISE=2
.meas TRAN F05 param 1/PER05
.meas TRAN FTEO05 param 1.443/((1k+2*RLDR05)*100n)
.meas TRAN ERR05 param abs(F05-FTEO05)/FTEO05*100
.meas TRAN VINT06 FIND V(V_INTERFAZ) AT 130m
.meas TRAN ILED06 FIND I(D_LED) AT 130m
.meas TRAN RLDR06 FIND V(RLDR) AT 130m
.meas TRAN PER06 TRIG V(OUT_555) VAL=2.5 TD=126m RISE=1 TARG V(OUT_555) VAL=2.5 TD=126m RISE=2
.meas TRAN F06 param 1/PER06
.meas TRAN FTEO06 param 1.443/((1k+2*RLDR06)*100n)
.meas TRAN ERR06 param abs(F06-FTEO06)/FTEO06*100
.meas TRAN VINT07 FIND V(V_INTERFAZ) AT 150m
.meas TRAN ILED07 FIND I(D_LED) AT 150m
.meas TRAN RLDR07 FIND V(RLDR) AT 150m
.meas TRAN PER07 TRIG V(OUT_555) VAL=2.5 TD=146m RISE=1 TARG V(OUT_555) VAL=2.5 TD=146m RISE=2
.meas TRAN F07 param 1/PER07
.meas TRAN FTEO07 param 1.443/((1k+2*RLDR07)*100n)
.meas TRAN ERR07 param abs(F07-FTEO07)/FTEO07*100
.meas TRAN VINT08 FIND V(V_INTERFAZ) AT 170m
.meas TRAN ILED08 FIND I(D_LED) AT 170m
.meas TRAN RLDR08 FIND V(RLDR) AT 170m
.meas TRAN PER08 TRIG V(OUT_555) VAL=2.5 TD=166m RISE=1 TARG V(OUT_555) VAL=2.5 TD=166m RISE=2
.meas TRAN F08 param 1/PER08
.meas TRAN FTEO08 param 1.443/((1k+2*RLDR08)*100n)
.meas TRAN ERR08 param abs(F08-FTEO08)/FTEO08*100
.meas TRAN VINT09 FIND V(V_INTERFAZ) AT 190m
.meas TRAN ILED09 FIND I(D_LED) AT 190m
.meas TRAN RLDR09 FIND V(RLDR) AT 190m
.meas TRAN PER09 TRIG V(OUT_555) VAL=2.5 TD=186m RISE=1 TARG V(OUT_555) VAL=2.5 TD=186m RISE=2
.meas TRAN F09 param 1/PER09
.meas TRAN FTEO09 param 1.443/((1k+2*RLDR09)*100n)
.meas TRAN ERR09 param abs(F09-FTEO09)/FTEO09*100
.meas TRAN VINT10 FIND V(V_INTERFAZ) AT 210m
.meas TRAN ILED10 FIND I(D_LED) AT 210m
.meas TRAN RLDR10 FIND V(RLDR) AT 210m
.meas TRAN PER10 TRIG V(OUT_555) VAL=2.5 TD=206m RISE=1 TARG V(OUT_555) VAL=2.5 TD=206m RISE=2
.meas TRAN F10 param 1/PER10
.meas TRAN FTEO10 param 1.443/((1k+2*RLDR10)*100n)
.meas TRAN ERR10 param abs(F10-FTEO10)/FTEO10*100
.meas TRAN VINT11 FIND V(V_INTERFAZ) AT 230m
.meas TRAN ILED11 FIND I(D_LED) AT 230m
.meas TRAN RLDR11 FIND V(RLDR) AT 230m
.meas TRAN PER11 TRIG V(OUT_555) VAL=2.5 TD=226m RISE=1 TARG V(OUT_555) VAL=2.5 TD=226m RISE=2
.meas TRAN F11 param 1/PER11
.meas TRAN FTEO11 param 1.443/((1k+2*RLDR11)*100n)
.meas TRAN ERR11 param abs(F11-FTEO11)/FTEO11*100
.meas TRAN VINT12 FIND V(V_INTERFAZ) AT 250m
.meas TRAN ILED12 FIND I(D_LED) AT 250m
.meas TRAN RLDR12 FIND V(RLDR) AT 250m
.meas TRAN PER12 TRIG V(OUT_555) VAL=2.5 TD=246m RISE=1 TARG V(OUT_555) VAL=2.5 TD=246m RISE=2
.meas TRAN F12 param 1/PER12
.meas TRAN FTEO12 param 1.443/((1k+2*RLDR12)*100n)
.meas TRAN ERR12 param abs(F12-FTEO12)/FTEO12*100
.meas TRAN VINT13 FIND V(V_INTERFAZ) AT 270m
.meas TRAN ILED13 FIND I(D_LED) AT 270m
.meas TRAN RLDR13 FIND V(RLDR) AT 270m
.meas TRAN PER13 TRIG V(OUT_555) VAL=2.5 TD=266m RISE=1 TARG V(OUT_555) VAL=2.5 TD=266m RISE=2
.meas TRAN F13 param 1/PER13
.meas TRAN FTEO13 param 1.443/((1k+2*RLDR13)*100n)
.meas TRAN ERR13 param abs(F13-FTEO13)/FTEO13*100
.meas TRAN VINT14 FIND V(V_INTERFAZ) AT 290m
.meas TRAN ILED14 FIND I(D_LED) AT 290m
.meas TRAN RLDR14 FIND V(RLDR) AT 290m
.meas TRAN PER14 TRIG V(OUT_555) VAL=2.5 TD=286m RISE=1 TARG V(OUT_555) VAL=2.5 TD=286m RISE=2
.meas TRAN F14 param 1/PER14
.meas TRAN FTEO14 param 1.443/((1k+2*RLDR14)*100n)
.meas TRAN ERR14 param abs(F14-FTEO14)/FTEO14*100
.meas TRAN VINT15 FIND V(V_INTERFAZ) AT 310m
.meas TRAN ILED15 FIND I(D_LED) AT 310m
.meas TRAN RLDR15 FIND V(RLDR) AT 310m
.meas TRAN PER15 TRIG V(OUT_555) VAL=2.5 TD=306m RISE=1 TARG V(OUT_555) VAL=2.5 TD=306m RISE=2
.meas TRAN F15 param 1/PER15
.meas TRAN FTEO15 param 1.443/((1k+2*RLDR15)*100n)
.meas TRAN ERR15 param abs(F15-FTEO15)/FTEO15*100
